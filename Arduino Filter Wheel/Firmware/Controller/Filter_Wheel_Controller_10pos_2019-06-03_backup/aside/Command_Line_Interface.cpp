/*------------------------------------------------------------
| Illumination_LED_Spectral_Light_Controller.cpp           (c) 2012 Peripheral Vision, Inc.
|-------------------------------------------------------------
|
| PURPOSE: Main application for the Fluorescent Light Controller
|
| DESCRIPTION: This program controlls two dimmable fluorescent channel
|				ballasts.  Each ballast is turned on/off by a relay.
| 				The ballast brightness is controlled by a 0-10V control
|				voltage, generated by a PWM signal.
|
| HISTORY:
|   15Feb11 TL - original sample application
|	04Jun12 MAO - fleshing out the actual application
------------------------------------------------------------*/

#include "Arduino.h"

#include <avr/wdt.h>

#include "Illumination_LED_Spectral_v2.h"
#include "Command_Line_Interface.h"
#include "CommandParser.h"
#include "Parser.h"
#include "Driver_LED_array.h"
#include "EEPROM_Memory_Map.h"
#include "Pin_Definitions.h"
#include "Driver_AD5066_Array.h"
#include "EEPROM.h"
#include "Lamp_Controller.h"

extern	Driver_LED_Array_Class	Driver_LED_Array;		// Global instantiation of the class

/*------------------------------------------------------------
| CommandStringList
|-------------------------------------------------------------
|
| PURPOSE: To list all the commands that the parser can
|          respond to.
|
| DESCRIPTION: To work with the command parser, these are the
| constraints on valid command names:
|
|      1. Use one or more non-whitespace characters.
|
|      2. If letters are used, they must be listed in this
|         table as upper case because the parser maps any
|         lower case letters to upper case for purposes of
|         string matching. In other words, the parser accepts
|         either "ON" and "on" as being valid for the same
|         function.
|
| There is a one-to-one correspondence between the items in
| this list and the service routines in the
| CommandHandlerTable[].
|
| HISTORY:
|   05Feb11 TL
| 	04Jun12 MO - Adding channel control commands
------------------------------------------------------------*/
char* CommandStringList[] =
{
	0,										   // Place holder: valid commands start at 1.
	"HELP",									   // 1.	Print help info, a list of commands.
	"?",									   // 2.	Print help info, a list of commands.
	"*IDN?",								   // 3.	Report the identity of this instrument.

	"RESET",
	"GFV",
	"ZXCVSSN",
	"GSN",

	"GBN",
	"GCN",										// get the number of channels

	"SP",									   	// Set LED power enable
	"GP",									   	// Get LED power enable

	"SGL",										// set the global light level.  Ranges from 0.0 to 1.0.  Scales all the channels
	"GGL",										// get the global light level.

	"SAB",										// set active buffer
	"GAB",										// get active buffer
	"SBL",										// set buffer level
	"GBL",										// get buffer level
	"ABL",										// set all levels in the current buffer to the same value

	"SAU",										// Set auto update state
	"GAU",										// Get auto update state
	"ABO",										// Apply buffer to output
												//
	"GAL",										// get the currently active level
												//
	"SSL",										// Zero all except a single channel and write directly to the DAC

	"FOU",										// Force output update

	"SMF",									   // 4. 	Set modulation frequency
	"GMF",									   // 5. 	Get modulation frequency
	"SMD",									   // 4. 	Set modulation depth ( 0% to 100%)
	"GMD",									   // 5. 	Get modulation depth ( 0% to 100%)
	"SMW",									   // 4. 	Set waveform
	"GMW",									   // 5. 	Get waveform

	"SSE",
	"GSE",
	"RS",

	"SSP",										// set strobe parameters
	"GSP",										// get strobe parameters
	"FS",										// fire the strobe

    "SJO",                                      // Set jack output 
	"GJO",                                      // Get jack output 
    "RJL",                                      // Read jack level
	0										   	// Zero is used as the list delimiter.
};

// Parser handler function table
Command CommandHandlerTable[] =
{
	0,										   // Place holder: valid commands start at 1.
	CmdHandler_HELP,						   // 1.  	HELP
	CmdHandler_HELP,						   // 2.  	?
	CmdHandler_IDN,							   // 3. 	IDN?

	CmdHandler_SW_RESET,
	CmdHandler_GET_FIRMWARE_VERSION,
	CmdHandler_SET_SERIAL_NUMBER,
	CmdHandler_GET_SERIAL_NUMBER,

	CmdHandler_GET_BUFFER_COUNT,
	CmdHandler_GET_CHANNEL_COUNT,			   // 3. 	IDN?
											   //
	CmdHandler_SET_LED_POWER_ENABLE,				   // 4. 	SET_ENABLE
	CmdHandler_GET_LED_POWER_ENABLE,				   // 5. 	GET_ENABLE

	CmdHandler_SET_GLOBAL_LEVEL,
	CmdHandler_GET_GLOBAL_LEVEL,

	CmdHandler_SET_SELECTED_BUFFER,
	CmdHandler_GET_SELECTED_BUFFER,
	CmdHandler_SET_BUFFER_LEVEL,
	CmdHandler_GET_BUFFER_LEVEL,
	CmdHandler_SET_BUFFER_LEVEL_ALL,

	CmdHandler_SET_AUTO_OUTPUT_UPDATE,
	CmdHandler_GET_AUTO_OUTPUT_UPDATE,

	CmdHandler_APPLY_BUFFER_TO_OUTPUT,
//	CmdHandler_SET_NORMALIZED_CHANNEL_LEVEL,
//	CmdHandler_GET_NORMALIZED_CHANNEL_LEVEL,

	CmdHandler_GET_ACTIVE_LEVEL,

	CmdHandler_SET_SINGLE_CHANNEL_UNBUFFERED,

	CmdHandler_UPDATE_OUTPUT,

	CmdHandler_SET_LAMP_FREQUENCY,			   // 4. 	SET_FREQUENCY
	CmdHandler_GET_LAMP_FREQUENCY,			   // 5. 	GET_FREQUENCY
	CmdHandler_SET_LAMP_MODULATION_DEPTH,	   // 4. 	SET_MODULATION
	CmdHandler_GET_LAMP_MODULATION_DEPTH,	   // 5. 	GET_MODULATION
	CmdHandler_SET_LAMP_WAVEFORM,			   // 4. 	SET_WAVEFORM
	CmdHandler_GET_LAMP_WAVEFORM,			   // 5. 	GET_WAVEFORM
											   //
	CmdHandler_SET_SEQUENCE_ENTRY,
	CmdHandler_GET_SEQUENCE_ENTRY,
	CmdHandler_RUN_SEQUENCE,

	CmdHandler_SET_STROBE_PARAMS,
	CmdHandler_GET_STROBE_PARAMS,
	CmdHandler_FIRE_STROBE,

    CmdHandler_SET_JACK_OUTPUT,
	CmdHandler_GET_JACK_OUTPUT,
    CmdHandler_READ_JACK_LEVEL,
};

//------------------------------------------------------------
//	Global Variables
//------------------------------------------------------------



	// set up the command handler
void	Command_Line_Interface_Init( void ) {

	CommandParserInit( CommandStringList, CommandHandlerTable );
}


void	Command_Line_Interface_Service( void ) {

		// Service the CLI
	CommandParserService();
}


//------------------------------------------------------------
// Command_Line_Interface_Param_Count_Check
//------------------------------------------------------------
bool	Command_Line_Interface_Param_Count_Check( uint8_t uMin_Count, uint8_t uMax_Count ) {

	if ( TheParameterCount < uMin_Count  ) {

		TheParsingStatus = PARSE_MISSING_PARAMETER;
		IMA_MSG( "Error - " );

		return false;
	}

	if ( TheParameterCount > uMax_Count  ) {

		TheParsingStatus = PARSE_TOO_MANY_PARAMETERS;
		IMA_MSG( "Error - " );

		return false;
	}

	return true;
}


//------------------------------------------------------------
// Command_Line_Interface_Param_Integer_Value_Check
//------------------------------------------------------------
bool	Command_Line_Interface_Param_Integer_Value_Check( uint8_t uParam_ID, uint32_t uMin_Value, uint32_t uMax_Value ) {

	if ( (TheParameters[uParam_ID] >= uMin_Value  ) && (TheParameters[uParam_ID] <= uMax_Value ) ) {
		return true;
	}

	TheParsingStatus = PARSE_PARAMETER_OUT_OF_BOUNDS;
	IMA_MSG( "Error - " );

	return false;
}


//------------------------------------------------------------
// Command_Line_Interface_Param_Float_Value_Check
//------------------------------------------------------------
bool	Command_Line_Interface_Param_Float_Value_Check( uint8_t uParam_ID, float fMin_Value, float fMax_Value ) {

	if ( (TheParametersFloat[uParam_ID] >= fMin_Value  ) && (TheParametersFloat[uParam_ID] <= fMax_Value ) ) {
		return true;
	}

	TheParsingStatus = PARSE_PARAMETER_OUT_OF_BOUNDS;
	IMA_MSG( "Error - " );

	return false;
}


/*------------------------------------------------------------
| CmdHandler_HELP
|-------------------------------------------------------------
|
| PURPOSE: To print help information about the supported
|          commands.
|
| DESCRIPTION: This routine prints out a list of commands
| and syntax information.
|
| HISTORY:
|   15Feb11 TL
|   25Feb11 Added CALIBRATE command.
|   28Feb11 Added FORWARD and BACK.
------------------------------------------------------------*/
void    CmdHandler_HELP( void ) {
	IMA_MSG_LN( "\r\nCommands" );
	IMA_MSG_LN( "-----------------------------------------------" );
	IMA_MSG_LN( "Capital letters are required, lower case are optional" );
	IMA_MSG_LN( "Help or ?\tHelp screen" );
	IMA_MSG_LN( "*IDN?\t\tGet device ID string" );
	IMA_MSG_LN( "RESET\t\tTrigger a hard reset" );
	IMA_MSG_LN( "GFV\t\tGet firmware version" );
	IMA_MSG_LN( "GSN\t\tGet serial number" );

	IMA_MSG_LN( "GBN \t\tGet number of channel buffers" );
	IMA_MSG_LN( "GCN \t\tGet number of LED channels" );

	IMA_MSG_LN( "SP <channel id> <0|1>\tEnable LED power" );
	IMA_MSG_LN( "GP <channel id>\tGet LED power state" );

	IMA_MSG_LN( "SGL <level>\tSet global level" );
	IMA_MSG_LN( "GGL\t\tGet global level" );

	IMA_MSG_LN( "SAB <buffer id>\tSet active buffer" );
	IMA_MSG_LN( "GAB <buffer id>\tGet active buffer" );

	IMA_MSG_LN( "SBL <channel id> <level>\tSet buffer level" );
	IMA_MSG_LN( "GBL <channel id>\tGet buffer level" );
	IMA_MSG_LN( "ABL <level>\tSet all LED levels to the same value" );

	IMA_MSG_LN( "SSL <channel id> <level>\tEnable only a single channel to the supplied level.  All other channels are 0" );

	IMA_MSG_LN( "SAU <0|1>\tSet output auto update" );
	IMA_MSG_LN( "GAU <0|1>\tGet output auto update" );
	IMA_MSG_LN( "UO\t\tUpdate DAC outputs" );

    IMA_MSG_LN( "SJO <0|1>\tSet jack output" );
    IMA_MSG_LN( "GJL\t\tGet jack level" );
}


/*------------------------------------------------------------
| CmdHandler_IDN
|-------------------------------------------------------------
|
| PURPOSE: Return a device ID string
|
| DESCRIPTION: This routine gets called to handle the
| "*IDN?" command.
|
| HISTORY:
|   02Mar11    MAO
------------------------------------------------------------*/
void    CmdHandler_IDN( void ) {

	// Report the instrument device identifier string.
	IMA_MSG( "Peripheral Vision Spectrally Programmable LED Light Source Controller" );

}


/*------------------------------------------------------------
| CmdHandler_GET_FIRMWARE_VERSION
|-------------------------------------------------------------
|
| PURPOSE: Return firmware version info
|
| DESCRIPTION:
|
| HISTORY:
|   02Mar11    MAO
------------------------------------------------------------*/
void    CmdHandler_GET_FIRMWARE_VERSION( void ) {

	if ( !Command_Line_Interface_Param_Count_Check( 0, 0 ) ) return;

	IMA_MSG( "GFV " );
    IMA_MSG_LN( FIRMWARE_VERSION );

}


//------------------------------------------------------------
// IMAHandler_Set_Serial_Number
//------------------------------------------------------------
void	CmdHandler_SET_SERIAL_NUMBER( void ) { 		   	// 21.

	unsigned long	ulSerialNumber;

	if ( !Command_Line_Interface_Param_Count_Check( 1, 1) ) return;

    IMA_MSG( "SSN " );
    IMA_MSG_VAL( TheParameters[0], DEC );
    IMA_MSG_LN( "" );

	ulSerialNumber = TheParameters[0];
	Save_To_EEPROM( &ulSerialNumber, sizeof( unsigned long), EEPROM_MEMORY_MAP_SERIAL_NUMBER_ADDR );

}

//------------------------------------------------------------
// IMAHandler_Get_SN
//------------------------------------------------------------
void	CmdHandler_GET_SERIAL_NUMBER( void ) { 		   	// 21.

	unsigned long	ulSerialNumber;

	if ( !Command_Line_Interface_Param_Count_Check( 0, 0 ) ) return;

	Load_From_EEPROM( &ulSerialNumber, sizeof( unsigned long), EEPROM_MEMORY_MAP_SERIAL_NUMBER_ADDR );

	IMA_MSG( "GSN " );
    IMA_MSG_VAL( ulSerialNumber, DEC );
    IMA_MSG_LN( "" );


}

//------------------------------------------------------------
// IMAHandler_SW_RESET
//------------------------------------------------------------
void	CmdHandler_SW_RESET( void ) { 		   	// 22

	if ( !Command_Line_Interface_Param_Count_Check( 0, 0 ) ) return;

	// Turn on the WDT and wait for it to timeout
	wdt_enable(WDTO_15MS);
	while( 1 ) {}

}


/*------------------------------------------------------------
| CmdHandler_GET_BUFFER_COUNT
|-------------------------------------------------------------
|
| PURPOSE: Return return the number of buffer banks
|
| DESCRIPTION:
|
| HISTORY:
|   02Mar11    MAO
------------------------------------------------------------*/
void    CmdHandler_GET_BUFFER_COUNT( void ) {

	if ( !Command_Line_Interface_Param_Count_Check( 0, 0 ) ) return;

	// Report the number of supported LED buffers
	IMA_MSG( "GBN " );
	IMA_MSG_VAL( Driver_LED_Array.Get_Buffer_Count(), DEC );
	IMA_MSG_LN( "" );

}


/*------------------------------------------------------------
| CmdHandler_GET_CHANNEL_COUNT
|-------------------------------------------------------------
|
| PURPOSE: Return return the number of channel banks
|
| DESCRIPTION:
|
| HISTORY:
|   02Mar11    MAO
------------------------------------------------------------*/
void    CmdHandler_GET_CHANNEL_COUNT( void ) {

	if ( !Command_Line_Interface_Param_Count_Check( 0, 0 ) ) return;

	// Report the number of supported LED channels
	IMA_MSG( "GCN " );
	IMA_MSG_VAL( Driver_LED_Array.Get_Channel_Count(), DEC );
	IMA_MSG_LN( "" );

}


/*------------------------------------------------------------
| CmdHandler_SET_LED_POWER_ENABLE
|-------------------------------------------------------------
|
| PURPOSE: Enable all channels at once
|
| DESCRIPTION:
|
|
| EXAMPLE:
|
| HISTORY:
|   19Jan12 MO
------------------------------------------------------------*/
void    CmdHandler_SET_LED_POWER_ENABLE( void ) {

	IMA_DEBUG_MSG_LN( "CmdHandler_SET_LED_POWER_ENABLE: begin..." );

	IMA_MSG( "SP " );

	if ( !Command_Line_Interface_Param_Count_Check( 1, 1 ) ) return;
	if ( !Command_Line_Interface_Param_Integer_Value_Check( 0, 0, 1 ) ) return;

	// Set the LED power as requeseted
	if ( TheParameters[0] >= 1 ) {
		IMA_DEBUG_MSG( "Turning LED power ON" );
		Driver_LED_Array.Set_LED_Power_Enable( true );
		IMA_MSG_LN( "1" );
	} else {
		IMA_DEBUG_MSG( "Turning LED power OFF" );
		Driver_LED_Array.Set_LED_Power_Enable( false );
		IMA_MSG_LN( "0" );
	}

	IMA_DEBUG_MSG_LN( "CmdHandler_SET_LED_POWER_ENABLE: done." );
}


/*------------------------------------------------------------
| CmdHandler_GET_AUTO_OUTPUT_UPDATE
|-------------------------------------------------------------
|
| PURPOSE: Enable all channels at once
|
| DESCRIPTION:
|
|
| EXAMPLE:
|
| HISTORY:
|   19Jan12 MO
------------------------------------------------------------*/
void    CmdHandler_GET_LED_POWER_ENABLE( void ) {

	IMA_DEBUG_MSG_LN( "CmdHandler_GET_LED_POWER_ENABLE: begin..." );

	IMA_MSG( "GP " );

	if ( !Command_Line_Interface_Param_Count_Check( 0, 0 ) ) return;

	// report the level
	IMA_MSG_VAL( Driver_LED_Array.Get_LED_Power_Enable(), DEC);
	IMA_MSG_LN( "" );



	IMA_DEBUG_MSG_LN( "CmdHandler_GET_LED_POWER_ENABLE: done." );
}


/*------------------------------------------------------------
| CmdHandler_SET_GLOBAL_LEVEL
|-------------------------------------------------------------
|
| PURPOSE: Set the global brightness level
|
| DESCRIPTION:
|
|
| EXAMPLE:
|
| HISTORY:
|   19Jan12 MO
------------------------------------------------------------*/
void    CmdHandler_SET_GLOBAL_LEVEL( void ) {

	IMA_DEBUG_MSG_LN( "CmdHandler_SET_GLOBAL_LEVEL: begin..." );

	IMA_MSG( "SGL " );

	if ( !Command_Line_Interface_Param_Count_Check( 1, 1 ) ) return;
	if ( !Command_Line_Interface_Param_Integer_Value_Check( 0, 0, 65535 ) ) return;

	// Set LED channel level
	Driver_LED_Array.Set_Global_Level( TheParameters[0] );

	IMA_MSG_VAL( TheParameters[0], DEC);
	IMA_MSG_LN( "" );

	IMA_DEBUG_MSG_LN( "CmdHandler_SET_GLOBAL_LEVEL: done." );
}


/*------------------------------------------------------------
| CmdHandler_GET_GLOBAL_LEVEL
|-------------------------------------------------------------
|
| PURPOSE: Get the current global power level
|
| DESCRIPTION:
|
|
| EXAMPLE:
|
| HISTORY:
|   18Jun12 MO
------------------------------------------------------------*/
void    CmdHandler_GET_GLOBAL_LEVEL( void ) {

	IMA_DEBUG_MSG_LN( "CmdHandler_GET_GLOBAL_LEVEL: begin..." );

	IMA_MSG( "GGL ");

	if ( !Command_Line_Interface_Param_Count_Check( 0, 0 ) ) return;

	IMA_MSG_VAL( Driver_LED_Array.Get_Global_Level(), DEC);
	IMA_MSG_LN( "" );

	IMA_DEBUG_MSG_LN( "CmdHandler_GET_GLOBAL_LEVEL: done." );
}


/*------------------------------------------------------------
| CmdHandler_SET_SELECTED_BUFFER
|-------------------------------------------------------------
|
| PURPOSE:
|
| DESCRIPTION:
|
|
| EXAMPLE:
|
| HISTORY:
|   19Jan12 MO
------------------------------------------------------------*/
void	CmdHandler_SET_SELECTED_BUFFER( void ) {

	IMA_DEBUG_MSG_LN( "CmdHandler_SET_SELECTED_BUFFER: begin..." );

	IMA_MSG( "SAB " );

	if ( !Command_Line_Interface_Param_Count_Check( 1, 1 ) ) return;
	if ( !Command_Line_Interface_Param_Integer_Value_Check( 0, 0, (Driver_LED_Array.Get_Buffer_Count()-1) ) ) return;

	// Set DAC level
	Driver_LED_Array.Set_Selected_Buffer( TheParameters[0] );

	// print the channel and level
	IMA_MSG_VAL( TheParameters[0], DEC);
	IMA_MSG_LN( "" );

	IMA_DEBUG_MSG_LN( "CmdHandler_SET_SELECTED_BUFFER: done." );
}


/*------------------------------------------------------------
| CmdHandler_GET_SELECTED_BUFFER
|-------------------------------------------------------------
|
| PURPOSE:
|
| DESCRIPTION:
|
|
| EXAMPLE:
|
| HISTORY:
|   19Jan12 MO
------------------------------------------------------------*/
void	CmdHandler_GET_SELECTED_BUFFER( void ) {

	IMA_DEBUG_MSG_LN( "CmdHandler_GET_SELECTED_BUFFER: begin..." );

	IMA_MSG( "GAB ");

	if ( !Command_Line_Interface_Param_Count_Check( 0, 0 ) ) return;

	IMA_MSG_VAL( Driver_LED_Array.Get_Selected_Buffer(), DEC);
	IMA_MSG_LN( "" );

	IMA_DEBUG_MSG_LN( "CmdHandler_GET_SELECTED_BUFFER: done." );}


/*------------------------------------------------------------
| CmdHandler_SET_BUFFER_LEVEL
|-------------------------------------------------------------
|
| PURPOSE: Set the current DAC output value
|
| DESCRIPTION:
|
|
| EXAMPLE:
|
| HISTORY:
|   19Jan12 MO
------------------------------------------------------------*/
void    CmdHandler_SET_BUFFER_LEVEL( void ) {

	IMA_DEBUG_MSG_LN( "CmdHandler_SET_BUFFER_LEVEL: begin..." );

	IMA_MSG( "SBL " );

	if ( !Command_Line_Interface_Param_Count_Check( 2, 2 ) ) return;
	if ( !Command_Line_Interface_Param_Integer_Value_Check( 0, 0, (Driver_LED_Array.Get_Channel_Count()-1) ) ) return;
	if ( !Command_Line_Interface_Param_Integer_Value_Check( 1, 0, AD5066_MAX_OUTPUT_LEVEL ) ) return;

	// Set DAC level
	Driver_LED_Array.Set_Buffer_Channel_Level( TheParameters[0], TheParameters[1] );

	// print the channel and level
	IMA_MSG_VAL( TheParameters[0], DEC);
	IMA_MSG( " " );
	IMA_MSG_VAL( TheParameters[1], DEC);
	IMA_MSG_LN( "" );

	IMA_DEBUG_MSG_LN( "CmdHandler_SET_BUFFER_LEVEL: done." );
}


/*------------------------------------------------------------
| CmdHandler_GET_BUFFER_LEVEL
|-------------------------------------------------------------
|
| PURPOSE: Get the current DAC output value
|
| DESCRIPTION:
|
|
| EXAMPLE:
|
| HISTORY:
|   18Jun12 MO
------------------------------------------------------------*/
void    CmdHandler_GET_BUFFER_LEVEL( void ) {

	uint16_t	uLevel;

	IMA_DEBUG_MSG_LN( "CmdHandler_GET_BUFFER_CHANNEL_LEVEL: begin..." );

	IMA_MSG( "GBL ");

	if ( !Command_Line_Interface_Param_Count_Check( 1, 1 ) ) return;

	// make sure the channel ID is within bounds
	if ( !Command_Line_Interface_Param_Integer_Value_Check( 0, 0, (Driver_LED_Array.Get_Channel_Count()-1) ) ) return;

	// Report the current level
	uLevel = Driver_LED_Array.Get_Buffer_Channel_Level( TheParameters[0] );

	IMA_MSG_VAL( TheParameters[0], DEC);
	IMA_MSG( " " );
	IMA_MSG_VAL( uLevel, DEC);
	IMA_MSG_LN( "" );
	IMA_DEBUG_MSG_LN( "CmdHandler_GET_BUFFER_CHANNEL_LEVEL: done." );
}


/*------------------------------------------------------------
| CmdHandler_SET_BUFFER_LEVEL_ALL
|-------------------------------------------------------------
|
| PURPOSE: Set All channel levels
|
| DESCRIPTION:
|
|
| EXAMPLE:
|
| HISTORY:
|   19Jan12 MO
------------------------------------------------------------*/
void    CmdHandler_SET_BUFFER_LEVEL_ALL( void ) {

	int i;

	IMA_DEBUG_MSG_LN( "CmdHandler_SET_BUFFER_LEVEL_ALL: begin..." );

	IMA_MSG( "ABL " );

	if ( !Command_Line_Interface_Param_Count_Check( 1, 1 ) ) return;
	if ( !Command_Line_Interface_Param_Integer_Value_Check( 0, 0, AD5066_MAX_OUTPUT_LEVEL ) ) return;

	// Set LED channel level
	for( i=0; i!=Driver_LED_Array.Get_Channel_Count(); i++ ) {
		Driver_LED_Array.Set_Buffer_Channel_Level( i, TheParameters[0] );
	}

	IMA_MSG_VAL( TheParameters[0], DEC );
	IMA_MSG_LN( "" );

	IMA_DEBUG_MSG_LN( "CmdHandler_SET_BUFFER_LEVEL_ALL: done." );
}


/*------------------------------------------------------------
| CmdHandler_SET_AUTO_OUTPUT_UPDATE
|-------------------------------------------------------------
|
| PURPOSE: Controls whether updates are held or applied immediately
|
| DESCRIPTION:
|
|
| EXAMPLE:
|
| HISTORY:
|   19Jan12 MO
------------------------------------------------------------*/
void    CmdHandler_SET_AUTO_OUTPUT_UPDATE( void ) {

	IMA_DEBUG_MSG_LN( "CmdHandler_SET_AUTO_OUTPUT_UPDATE: begin..." );

	IMA_MSG( "SAU " );

	if ( !Command_Line_Interface_Param_Count_Check( 1, 1 ) ) return;
	if ( !Command_Line_Interface_Param_Integer_Value_Check( 0, 0, 1 ) ) return;

	// Set the auto update as requeseted
	if ( TheParameters[0] == 1 ) {
		IMA_DEBUG_MSG( "Turning LED power ON" );
		Driver_LED_Array.Set_Auto_Output_Update( true );
		IMA_MSG_LN( "1" );
	} else {
		IMA_DEBUG_MSG( "Turning LED power OFF" );
		Driver_LED_Array.Set_Auto_Output_Update( false );
		IMA_MSG_LN( "0" );
	}

	IMA_DEBUG_MSG_LN( "CmdHandler_SET_AUTO_OUTPUT_UPDATE: done." );
}


/*------------------------------------------------------------
| CmdHandler_GET_AUTO_OUTPUT_UPDATE
|-------------------------------------------------------------
|
| PURPOSE: Enable all channels at once
|
| DESCRIPTION:
|
|
| EXAMPLE:
|
| HISTORY:
|   19Jan12 MO
------------------------------------------------------------*/
void    CmdHandler_GET_AUTO_OUTPUT_UPDATE( void ) {

	IMA_DEBUG_MSG_LN( "CmdHandler_GET_AUTO_OUTPUT_UPDATE: begin..." );

	IMA_MSG( "GAU " );

	if ( !Command_Line_Interface_Param_Count_Check( 0, 0 ) ) return;

	// report the level
	IMA_MSG_VAL( Driver_LED_Array.Get_Auto_Output_Update(), DEC);
	IMA_MSG_LN( "" );



	IMA_DEBUG_MSG_LN( "CmdHandler_GET_AUTO_OUTPUT_UPDATE: done." );
}


/*------------------------------------------------------------
| CmdHandler_APPLY_BUFFER_TO_OUTPUT
|-------------------------------------------------------------
|
| PURPOSE: Get the current DAC output value
|
| DESCRIPTION:
|
|
| EXAMPLE:
|
| HISTORY:
|   18Jun12 MO
------------------------------------------------------------*/
void	CmdHandler_APPLY_BUFFER_TO_OUTPUT( void )	{

	IMA_DEBUG_MSG_LN( "CmdHandler_APPLY_BUFFER_TO_OUTPUT: begin..." );

	IMA_MSG( "ABO " );

	if ( !Command_Line_Interface_Param_Count_Check( 1, 1 ) ) return;
	if ( !Command_Line_Interface_Param_Integer_Value_Check( 0, 0, (Driver_LED_Array.Get_Buffer_Count()-1) ) ) return;

	// Set DAC level
	Driver_LED_Array.Apply_Buffer_to_Active( TheParameters[0] );

	// print the channel and level
	IMA_MSG_VAL( TheParameters[0], DEC);
	IMA_MSG_LN( "" );

	IMA_DEBUG_MSG_LN( "CmdHandler_APPLY_BUFFER_TO_OUTPUT: done." );
}




/*------------------------------------------------------------
| CmdHandler_GET_ACTIVE_LEVEL
|-------------------------------------------------------------
|
| PURPOSE: Get the current DAC output value
|
| DESCRIPTION:
|
|
| EXAMPLE:
|
| HISTORY:
|   18Jun12 MO
------------------------------------------------------------*/
void    CmdHandler_GET_ACTIVE_LEVEL( void ) {

	uint16_t	uLevel;

	IMA_DEBUG_MSG_LN( "CmdHandler_GET_ACTIVE_CHANNEL_LEVEL: begin..." );

	IMA_MSG( "GAL ");

	if ( !Command_Line_Interface_Param_Count_Check( 1, 1 ) ) return;

	// make sure the channel ID is within bounds
	if ( !Command_Line_Interface_Param_Integer_Value_Check( 0, 0, (Driver_LED_Array.Get_Channel_Count()-1) ) ) return;

	// Report the current level
	uLevel = Driver_LED_Array.Get_Actual_Channel_Level( TheParameters[0] );

	IMA_MSG_VAL( TheParameters[0], DEC);
	IMA_MSG( " " );
	IMA_MSG_VAL( uLevel, DEC);
	IMA_MSG_LN( "" );
	IMA_DEBUG_MSG_LN( "CmdHandler_GET_ACTIVE_CHANNEL_LEVEL: done." );
}


/*------------------------------------------------------------
| CmdHandler_SET_SINGLE_CHANNEL_UNBUFFERED
|-------------------------------------------------------------
|
| PURPOSE: Turn on a signel channel, turning off all others
|
| DESCRIPTION:
|
|
| EXAMPLE:
|
| HISTORY:
|   19Jan12 MO
------------------------------------------------------------*/
void    CmdHandler_SET_SINGLE_CHANNEL_UNBUFFERED( void ) {

	int i;

	IMA_DEBUG_MSG_LN( "CmdHandler_SET_SINGLE_LEVEL: begin..." );

	IMA_MSG( "SSL " );

	if ( !Command_Line_Interface_Param_Count_Check( 2, 2) ) return;
	if ( !Command_Line_Interface_Param_Integer_Value_Check( 0, 0, (Driver_LED_Array.Get_Channel_Count()-1) ) ) return;
	if ( !Command_Line_Interface_Param_Integer_Value_Check( 1, 0, AD5066_MAX_OUTPUT_LEVEL ) ) return;

	// Set LED channel level
	for( i=0; i!=Driver_LED_Array.Get_Channel_Count(); i++ ) {

		if ( i == TheParameters[0] ) {
			Driver_LED_Array.Write_DAC_Channel_Unbuffered( i, TheParameters[1] );
		} else {
			Driver_LED_Array.Write_DAC_Channel_Unbuffered( i, 0 );
		}
	}

	IMA_MSG_VAL( TheParameters[0], DEC );
	IMA_MSG( " " );
	IMA_MSG_VAL( TheParameters[1], DEC );
	IMA_MSG_LN( "" );

	IMA_DEBUG_MSG_LN( "CmdHandler_SET_SINGLE_LEVEL: done." );
}


/*------------------------------------------------------------
| CmdHandler_UPDATE_OUTPUT
|-------------------------------------------------------------
|
| PURPOSE: Set a DAC output directly
|
| DESCRIPTION:
|
|
| EXAMPLE:
|
| HISTORY:
|   19Jan12 MO
------------------------------------------------------------*/
void	CmdHandler_UPDATE_OUTPUT( void ) {

	IMA_MSG( "FOU " );

	if ( !Command_Line_Interface_Param_Count_Check( 0, 0 ) ) return;

	// update all the DAC outputs simultaneously
	Driver_LED_Array.Write_Active_to_DAC();

	IMA_MSG_LN( "" );

}


/*------------------------------------------------------------
| CmdHandler_SET_LAMP_FREQUENCY
|-------------------------------------------------------------
|
| PURPOSE: Set the lamp modulation frequency
|
| DESCRIPTION:
|
|
| EXAMPLE:
|
| HISTORY:
|   19Jan12 MO
------------------------------------------------------------*/
void    CmdHandler_SET_LAMP_FREQUENCY( void ) {

	IMA_DEBUG_MSG_LN( "CmdHandler_SET_LAMP_FREQUENCY: begin..." );

	IMA_MSG( "SMF " );

	if ( !Command_Line_Interface_Param_Count_Check( 1, 1) ) return;
	if ( !Command_Line_Interface_Param_Float_Value_Check( 0, 0.0, 1000.0 ) ) return;

	// set the modulation frequency
	Lamp_Set_Frequency( TheParametersFloat[0] );

	// echo the command back
	IMA_MSG_VAL( TheParametersFloat[0], DEC);
	IMA_MSG_LN( "" );

	IMA_DEBUG_MSG_LN( "CmdHandler_SET_LAMP_FREQUENCY: done." );
}


/*------------------------------------------------------------
| CmdHandler_GET_FREQUENCY
|-------------------------------------------------------------
|
| PURPOSE: Get the current modulation frequency
|
| DESCRIPTION:
|
|
| EXAMPLE:
|
| HISTORY:
|   18Jun12 MO
------------------------------------------------------------*/
void    CmdHandler_GET_LAMP_FREQUENCY( void ) {

	IMA_DEBUG_MSG_LN( "CmdHandler_GET_FREQUENCY: begin..." );

	IMA_MSG( "GMF " );

	if ( !Command_Line_Interface_Param_Count_Check( 0, 0 ) ) return;

	// report the PWM frequency
	IMA_MSG_VAL( Lamp_Get_Frequency(), DEC);
	IMA_MSG_LN( "" );

	IMA_DEBUG_MSG_LN( "CmdHandler_GET_FREQUENCY: done." );
}


/*------------------------------------------------------------
| CmdHandler_SET_LAMP_MODULATION_DEPTH
|-------------------------------------------------------------
|
| PURPOSE: Set the lamp modulationdepth
|
| DESCRIPTION:
|
|
| EXAMPLE:
|
| HISTORY:
|   19Jan12 MO
------------------------------------------------------------*/
void    CmdHandler_SET_LAMP_MODULATION_DEPTH( void ) {

	IMA_DEBUG_MSG_LN( "CmdHandler_SET_LAMP_MODULATION_DEPTH: begin..." );

	IMA_MSG( "SMD " );

	if ( !Command_Line_Interface_Param_Count_Check( 1, 1) ) return;
	if ( !Command_Line_Interface_Param_Integer_Value_Check( 0, 0, 100 ) ) return;


	Lamp_Set_Modulation_Depth( TheParameters[0] );

	// echo the command back
	IMA_MSG_VAL( TheParameters[0], DEC);
	IMA_MSG_LN( "" );

	IMA_DEBUG_MSG_LN( "CmdHandler_SET_LAMP_MODULATION_DEPTH: done." );
}


/*------------------------------------------------------------
| CmdHandler_GET_MODULATION_DEPTH
|-------------------------------------------------------------
|
| PURPOSE: Get the current modulation modulation_depth
|
| DESCRIPTION:
|
|
| EXAMPLE:
|
| HISTORY:
|   18Jun12 MO
------------------------------------------------------------*/
void    CmdHandler_GET_LAMP_MODULATION_DEPTH( void ) {

	IMA_DEBUG_MSG_LN( "CmdHandler_GET_MODULATION_DEPTH: begin..." );

	IMA_MSG( "GMD " );

	if ( !Command_Line_Interface_Param_Count_Check( 0, 0 ) ) return;

	// report the PWM modulation_depth
	IMA_MSG_VAL( Lamp_Get_Modulation_Depth(), DEC);

	IMA_MSG_LN( "" );

	IMA_DEBUG_MSG_LN( "CmdHandler_GET_MODULATION_DEPTH: done." );
}


/*------------------------------------------------------------
| CmdHandler_SET_LAMP_WAVEFORM
|-------------------------------------------------------------
|
| PURPOSE: Set the lamp waveform
|
| DESCRIPTION:
|
|
| EXAMPLE:
|
| HISTORY:
|   19Jan12 MO
------------------------------------------------------------*/
void    CmdHandler_SET_LAMP_WAVEFORM( void ) {

	IMA_DEBUG_MSG_LN( "CmdHandler_SET_LAMP_WAVEFORM: begin..." );

	IMA_MSG( "SMW " );

	if ( !Command_Line_Interface_Param_Count_Check( 1, 1 ) ) return;
	if ( !Command_Line_Interface_Param_Integer_Value_Check( 0, 0, LAMP_WAVEFORM_NUM_O_WAVEFORMS ) ) return;


	Lamp_Set_Waveform_Type( TheParameters[0] );

	// echo the command back
	IMA_MSG_VAL( TheParameters[0], DEC);
	IMA_MSG_LN( "" );

	IMA_DEBUG_MSG_LN( "CmdHandler_SET_LAMP_WAVEFORM: done." );
}


/*------------------------------------------------------------
| CmdHandler_GET_WAVEFORM
|-------------------------------------------------------------
|
| PURPOSE: Get the current modulation waveform
|
| DESCRIPTION:
|
|
| EXAMPLE:
|
| HISTORY:
|   18Jun12 MO
------------------------------------------------------------*/
void    CmdHandler_GET_LAMP_WAVEFORM( void ) {

	IMA_DEBUG_MSG_LN( "CmdHandler_GET_WAVEFORM: begin..." );

	IMA_MSG( "GMW " );

	if ( !Command_Line_Interface_Param_Count_Check( 0, 0 ) ) return;

	// report the PWM waveform
	IMA_MSG_VAL( Lamp_Get_Waveform_Type(), DEC);

	IMA_MSG_LN( "" );

	IMA_DEBUG_MSG_LN( "CmdHandler_GET_WAVEFORM: done." );

}


/*------------------------------------------------------------
| Save_To_EEPROM
|-------------------------------------------------------------
|
| PURPOSE: Save data to EEPROM
|
| DESCRIPTION:
|
|
| EXAMPLE:
|
| HISTORY:
|   18Jun12 MO
------------------------------------------------------------*/
void    Save_To_EEPROM( void* pSource, int iSizeInBytes, unsigned int uiEEPROMStartAddr ) {

    unsigned char* pChar;
    int i, iAddr;

    pChar = (unsigned char*)pSource;
    for ( i=0; i!=iSizeInBytes; i++ ) {

        iAddr = i + uiEEPROMStartAddr;

        // write each byte only if it's different from the new value.
        if ( EEPROM.read( iAddr ) != *pChar ) {
            EEPROM.write( iAddr, *pChar );
        }
        *pChar++;
    }

}


/*------------------------------------------------------------
| Load_From_EEPROM
|-------------------------------------------------------------
|
| PURPOSE: Load data from EEPROM
|
| DESCRIPTION:
|
|
| EXAMPLE:
|
| HISTORY:
|   18Jun12 MO
------------------------------------------------------------*/
void    Load_From_EEPROM( void* pDest, int iSizeInBytes, unsigned int uiEEPROMStartAddr ) {

    unsigned char* pChar;
    int i, iAddr;

    pChar = (unsigned char*)pDest;

    for ( i=0; i!=iSizeInBytes; i++ ) {

        iAddr = i + uiEEPROMStartAddr;

        // read the state byte by byte
        *pChar = EEPROM.read( iAddr );

        pChar++;
    }

}


/*------------------------------------------------------------
| CmdHandler_SET_SEQUENCE_ENTRY
|-------------------------------------------------------------
|
| PURPOSE: Load data from EEPROM
|
| DESCRIPTION:
|
|
| EXAMPLE:
|
| HISTORY:
|   18Jun12 MO
------------------------------------------------------------*/
void	CmdHandler_SET_SEQUENCE_ENTRY( void ) {

	IMA_DEBUG_MSG_LN( "CmdHandler_SET_SEQUENCE_ENTRY: begin..." );

	IMA_MSG( "SSE " );

	if ( !Command_Line_Interface_Param_Count_Check( 3, 3 ) ) return;
	if ( !Command_Line_Interface_Param_Integer_Value_Check( 0, 0, LED_ARRAY_NUM_SEQUENCE_BUFFER_LENGTH-1 ) ) return;
	if ( !Command_Line_Interface_Param_Integer_Value_Check( 1, 0, LED_ARRAY_NUM_SEQUENCE_BUFFER_ID_EOF ) ) return;


	Driver_LED_Array.Set_Sequence_Entry( TheParameters[0], TheParameters[1], TheParameters[2] );

	// echo the command back
	IMA_MSG_VAL( TheParameters[0], DEC);
	IMA_MSG( " " );

	IMA_MSG_VAL( TheParameters[1], DEC);
	IMA_MSG( " " );

	IMA_MSG_VAL( TheParameters[2], DEC);

	IMA_MSG_LN( "" );

	IMA_DEBUG_MSG_LN( "CmdHandler_SET_SEQUENCE_ENTRY: done." );
}


/*------------------------------------------------------------
| CmdHandler_GET_SEQUENCE_ENTRY
|-------------------------------------------------------------
|
| PURPOSE: Load data from EEPROM
|
| DESCRIPTION:
|
|
| EXAMPLE:
|
| HISTORY:
|   18Jun12 MO
------------------------------------------------------------*/
void	CmdHandler_GET_SEQUENCE_ENTRY( void ) {

	IMA_DEBUG_MSG_LN( "CmdHandler_GET_SEQUENCE_ENTRY: begin..." );

	IMA_MSG( "GSE " );

	if ( !Command_Line_Interface_Param_Count_Check( 1, 1 ) ) return;
	if ( !Command_Line_Interface_Param_Integer_Value_Check( 0, 0, LED_ARRAY_NUM_SEQUENCE_BUFFER_LENGTH-1 ) ) return;

	IMA_MSG_VAL( TheParameters[0], DEC );
	IMA_MSG( " " );

	IMA_MSG_VAL( Driver_LED_Array.Get_Sequence_Entry_Buffer_ID( TheParameters[0] ), DEC );
	IMA_MSG( " " );

	IMA_MSG_VAL( Driver_LED_Array.Get_Sequence_Entry_Timestamp( TheParameters[0] ), DEC );

	IMA_MSG_LN( "" );

	IMA_DEBUG_MSG_LN( "CmdHandler_GET_SEQUENCE_ENTRY: done." );
}


/*------------------------------------------------------------
| CmdHandler_RUN_SEQUENCE
|-------------------------------------------------------------
|
| PURPOSE: Load data from EEPROM
|
| DESCRIPTION:
|
|
| EXAMPLE:
|
| HISTORY:
|   18Jun12 MO
------------------------------------------------------------*/
void	CmdHandler_RUN_SEQUENCE( void ) {

	IMA_DEBUG_MSG_LN( "CmdHandler_RUN_SEQUENCE: begin..." );

	IMA_MSG( "RS " );

	if ( !Command_Line_Interface_Param_Count_Check( 0, 0 ) ) return;

	Driver_LED_Array.Run_Sequence();

	IMA_MSG_LN( "" );

	IMA_DEBUG_MSG_LN( "CmdHandler_RUN_SEQUENCE: done." );
}


/*------------------------------------------------------------
| CmdHandler_SET_STROBE_PARAMS
|-------------------------------------------------------------
|
| PURPOSE: Load data from EEPROM
|
| DESCRIPTION:
|
|
| EXAMPLE:
|
| HISTORY:
|   18Jun12 MO
------------------------------------------------------------*/
void	CmdHandler_SET_STROBE_PARAMS( void ) {

	IMA_DEBUG_MSG_LN( "CmdHandler_SET_STROBE_PARAMS: begin..." );

	IMA_MSG( "SSP " );

	if ( !Command_Line_Interface_Param_Count_Check( 2, 2 ) ) return;
	if ( !Command_Line_Interface_Param_Integer_Value_Check( 0, 0, (Driver_LED_Array.Get_Buffer_Count()-1) ) ) return;
	// No need to check 2nd param, since it's a duration in us

	Driver_LED_Array.Set_Strobe_Params( TheParameters[0], TheParameters[1] );

	// echo the command back
	IMA_MSG_VAL( TheParameters[0], DEC);
	IMA_MSG( " " );

	IMA_MSG_VAL( TheParameters[1], DEC);

	IMA_MSG_LN( "" );

	IMA_DEBUG_MSG_LN( "CmdHandler_SET_STROBE_PARAMS: done." );
}


/*------------------------------------------------------------
| CmdHandler_GET_STROBE_PARAMS
|-------------------------------------------------------------
|
| PURPOSE:
|
| DESCRIPTION:
|
|
| EXAMPLE:
|
| HISTORY:
|   18Jun12 MO
------------------------------------------------------------*/
void	CmdHandler_GET_STROBE_PARAMS( void ) {

	IMA_DEBUG_MSG_LN( "CmdHandler_GET_STROBE_PARAMS: begin..." );

	IMA_MSG( "GSP " );

	if ( !Command_Line_Interface_Param_Count_Check( 0, 0 ) ) return;

	IMA_MSG_VAL( Driver_LED_Array.Get_Strobe_Buffer_ID(), DEC );
	IMA_MSG( " " );

	IMA_MSG_VAL( Driver_LED_Array.Get_Strobe_Period_in_us(), DEC );

	IMA_MSG_LN( "" );

	IMA_DEBUG_MSG_LN( "CmdHandler_GET_STROBE_PARAMS: done." );
}


/*------------------------------------------------------------
| CmdHandler_FIRE_STROBE
|-------------------------------------------------------------
|
| PURPOSE:
|
| DESCRIPTION:
|
|
| EXAMPLE:
|
| HISTORY:
|   18Jun12 MO
------------------------------------------------------------*/
void	CmdHandler_FIRE_STROBE( void ) {

	IMA_DEBUG_MSG_LN( "CmdHandler_FIRE_STROBE: begin..." );

	IMA_MSG( "FS " );

	if ( !Command_Line_Interface_Param_Count_Check( 0, 0 ) ) return;

	Driver_LED_Array.Fire_Strobe();

	IMA_MSG_LN( "" );

	IMA_DEBUG_MSG_LN( "CmdHandler_FIRE_STROBE: done." );
}



/*------------------------------------------------------------
| CmdHandler_SET_JACK_OUTPUT
|-------------------------------------------------------------
|
| PURPOSE:
|
| DESCRIPTION:
|
|
| EXAMPLE:
|
| HISTORY:
|   18Jun12 MO
------------------------------------------------------------*/
void	CmdHandler_SET_JACK_OUTPUT( void ) {

    IMA_DEBUG_MSG_LN( "CmdHandler_SET_JACK_OUTPUT: begin..." );

    IMA_MSG( "SJO " );

    if ( !Command_Line_Interface_Param_Count_Check( 1, 1 ) ) return;

    if ( !Command_Line_Interface_Param_Integer_Value_Check( 0, 0, 1 ) ) return;


    // Set the output accordingly
    digitalWrite( PIN_STROBE_DRIVE, TheParameters[0] );
    pinMode( PIN_STROBE_DRIVE, OUTPUT );

    // echo the command back
    IMA_MSG_VAL( TheParameters[0], DEC);
    IMA_MSG_LN( "" );

    IMA_DEBUG_MSG_LN( "CmdHandler_SET_JACK_OUTPUT: done." );
}


/*------------------------------------------------------------
| CmdHandler_GET_JACK_OUTPUT
|-------------------------------------------------------------
|
| PURPOSE:
|
| DESCRIPTION:
|
|
| EXAMPLE:
|
| HISTORY:
|   18Jun12 MO
------------------------------------------------------------*/
void	CmdHandler_GET_JACK_OUTPUT( void ) {

    IMA_DEBUG_MSG_LN( "CmdHandler_GET_JACK_OUTPUT: begin..." );

    IMA_MSG( "GJO " );

    if ( !Command_Line_Interface_Param_Count_Check( 0, 0 ) ) return;

    // report the current level
    IMA_MSG_VAL( digitalRead( PIN_STROBE_DRIVE ), DEC );
    IMA_MSG_LN( "" );

    IMA_DEBUG_MSG_LN( "CmdHandler_GET_JACK_OUTPUT: done." );

}


/*------------------------------------------------------------
| CmdHandler_READ_JACK_LEVEL
|-------------------------------------------------------------
|
| PURPOSE:
|
| DESCRIPTION:
|
|
| EXAMPLE:
|
| HISTORY:
|   18Jun12 MO
------------------------------------------------------------*/
void	CmdHandler_READ_JACK_LEVEL( void ) {

    IMA_DEBUG_MSG_LN( "CmdHandler_READ_JACK_LEVEL: begin..." );

    IMA_MSG( "RJL " );

    if ( !Command_Line_Interface_Param_Count_Check( 0, 0 ) ) return;

    // Get the output accordingly
    pinMode( PIN_STROBE_DRIVE, INPUT );

    // report the current level
    IMA_MSG_VAL( digitalRead( PIN_STROBE_DRIVE ), DEC );
    IMA_MSG_LN( "" );

    IMA_DEBUG_MSG_LN( "CmdHandler_READ_JACK_LEVEL: done." );
}

